## conf/machine/force4.conf
```bitbake
#
# This is config file for Iqon Force 4
#

KERNELVERSION = "4.1.20"

MTD_KERNEL = "mmcblk0p1"
MTD_ROOTFS = "mmcblk0p4"
SPLASH1_BMP = "splash1_power.bmp"

IMAGEDIR = "update/force4"

MACHINE_ESSENTIAL_EXTRA_RDEPENDS += "\
	dags-dvb-modules-dags72604 \
	"

require conf/machine/include/dags-arm.inc

PREFERRED_VERSION_linux-dags = "${KERNELVERSION}"

SOC_FAMILY = "bcm72604"

MACHINE_FEATURES += "emmc mmc dvb-c blindscan-dvbs swap"

DVBMEDIASINK_CONFIG = "--with-dags --with-pcm --with-eac3 --with-amr --with-wmv --with-h265 --with-vb9"

STB_PLATFORM = "dags72604"

RCNAME = "iqon1"
```

## conf/machine/lunix4k.conf
```bitbake
#
# This is config file for Qviart Lunix 4K
#

MTD_KERNEL = "mmcblk0p1"
MTD_ROOTFS = "mmcblk0p4"
SPLASH1_BMP = "splash1_power.bmp"

IMAGEDIR = "update/lunix4k"

MACHINE_ESSENTIAL_EXTRA_RDEPENDS += "\
    dags-dvb-modules-dags72604 \
    "

require conf/machine/include/dags7252.inc

MACHINE_FEATURES += "dvb-c blindscan-dvbs swap"

DVBMEDIASINK_CONFIG = "--with-dags --with-pcm --with-eac3 --with-amr --with-wmv --with-h265 --with-vb9"

RCNAME = "qviart3"
```
